/* symbols accepted unit records take from other units (witnessed overlay addresses) */
PROVIDE(__divdi3 = 0x00307EC0); /* libgcc */
PROVIDE(__moddi3 = 0x00308558); /* libgcc */
PROVIDE(__floatdisf = 0x003096D0); /* libgcc */
PROVIDE(fptodp = 0x00309B80); /* libgcc */
PROVIDE(dpsub = 0x00309E78); /* libgcc */
PROVIDE(dpmul = 0x00309EE0); /* libgcc */
PROVIDE(dpdiv = 0x0030A190); /* libgcc */
PROVIDE(dpcmp = 0x0030A308); /* libgcc */
PROVIDE(litodp = 0x0030A358); /* libgcc */
PROVIDE(dptoli = 0x0030A410); /* libgcc */
PROVIDE(dptofp = 0x0030A4E0); /* libgcc */
PROVIDE(__fixdfdi = 0x00317270); /* libgcc */
PROVIDE(D_00000000 = 0x00000000); /* VU1 microprogram at VU address 0: the MSCAL of filterMonotoneDraw */
PROVIDE(__fixunssfdi = 0x003098D0); /* libgcc: float to unsigned long long, called by gifStateDrawEchoBlur */
PROVIDE(dpadd = 0x00309E20); /* libgcc: double addition, called by xglMistEmitterDraw */
PROVIDE(D_00001B70 = 0x00001B70); /* VU1 microprogram address used by the sdv alter packets (sdvAlterDraw) */
PROVIDE(D_00001BD0 = 0x00001BD0); /* VU1 microprogram address used by the sdv alter packets (sdvAlterDraw) */
PROVIDE(D_004516B0_1F5CA8 = 0x004516B0); /* D_004516B0 in tu128 */
PROVIDE(D_004516B0_1F6698 = 0x004516B0); /* D_004516B0 in tu128 */
PROVIDE(D_004516B0_1F6DE0 = 0x004516B0); /* D_004516B0 in tu128 */
PROVIDE(D_004516B0_1F6EE8 = 0x004516B0); /* D_004516B0 in tu128 */
PROVIDE(D_004516B0_1F73C8 = 0x004516B0); /* D_004516B0 in tu128 */
PROVIDE(D_004516B0_1F74A8 = 0x004516B0); /* D_004516B0 in tu128 */
PROVIDE(D_004516B0_1F7588 = 0x004516B0); /* D_004516B0 in tu128 */
PROVIDE(D_004516B0_1F7668 = 0x004516B0); /* D_004516B0 in tu128 */
PROVIDE(gEffectTable_1F6DE0 = 0x004520B0); /* gEffectTable in tu128 */
PROVIDE(svResourceTypeLists_1F6EE8 = 0x00475600); /* svResourceTypeLists in tu128 */
PROVIDE(D_004081F0_1F9998 = 0x004081F0); /* D_004081F0 in tu129 */
PROVIDE(D_004516B0_1F8E28 = 0x004516B0); /* D_004516B0 in tu129 */
PROVIDE(gSdvAlters_1F1220 = 0x00630850); /* gSdvAlters in sdv */
PROVIDE(gSdvAlters_1F35E0 = 0x00630850); /* gSdvAlters in sdv */
PROVIDE(gSdvAlters_sdvDrawAlters = 0x00630850); /* gSdvAlters in sdv */
PROVIDE(D_004749F0_2037F8 = 0x004749F0); /* D_004749F0 in sef */
PROVIDE(D_004749F0_203990 = 0x004749F0); /* D_004749F0 in sef */
PROVIDE(D_005510A4_1FC620 = 0x005510A4); /* D_005510A4 in sef */
PROVIDE(D_005510A4_1FE6F0 = 0x005510A4); /* D_005510A4 in sef */
PROVIDE(D_00551514_2022F0 = 0x00551514); /* D_00551514 in sef */
PROVIDE(gSbStudioBlock_2018E8 = 0x00452D40); /* gSbStudioBlock in sef */
PROVIDE(sefDefaultPoint_205638 = 0x0053EEE0); /* sefDefaultPoint in sef_132 */
PROVIDE(sefEffectRecords_2002C8 = 0x0055104C); /* sefEffectRecords in sef */
PROVIDE(sefEffectTallies_201EA0 = 0x0076C000); /* sefEffectTallies in sef */
